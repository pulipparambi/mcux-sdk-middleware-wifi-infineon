## Kconfig
```kconfig
config MCUX_COMPONENT_WIFI_INFINEON
    bool "Infineon Wi-Fi Middleware"
    default n

    imply MCUX_COMPONENT_WIFI_INFINEON.whd-expansion
    imply MCUX_COMPONENT_WIFI_INFINEON.wifi-resources
    imply MCUX_COMPONENT_WIFI_INFINEON.wifi-connection-manager

config USE_WIFI_MFG_TEST
    bool "Enable wifi-mfg-test"
    default n

    imply USE_WIFI_MFG_TEST.wifi-mfg-test-app

if MCUX_COMPONENT_WIFI_INFINEON

config MCUX_COMPONENT_WIFI_INFINEON.whd-expansion
    bool

config MCUX_COMPONENT_WIFI_INFINEON.wifi-resources
    bool

config MCUX_COMPONENT_WIFI_INFINEON.wifi-connection-manager
    bool

endif
```

## west.yml
```yaml
manifest:
  remotes:
  - name: infineon
    url-base: https://github.com/infineon

  defaults:
    remote: infineon

  projects:

  # Infineon middleware libraries from public GitHub
  - name: whd-expansion
    remote: infineon
    revision: 54deecc6e51e661cff9e778752d9cf18e90607d5

  - name: wifi-resources
    remote: infineon
    revision: release-v2.0.0

  - name: wifi-connection-manager
    remote: infineon
    revision: release-v3.7.0
```
